## main/Kconfig.projbuild
```kconfig
menu "W5500 Ethernet Uplink"

    config ETH_W5500_ENABLED
        bool "Enable W5500 Ethernet uplink"
        default y
        help
            Enable the WIZnet W5500 SPI Ethernet driver as the primary internet
            uplink. When present, Ethernet is preferred over WiFi STA as the
            default route. The firmware falls back to WiFi-only if the W5500 is
            not detected at boot.

    config ETH_W5500_CS_GPIO
        int "W5500 CS (chip select) GPIO"
        default 2
        depends on ETH_W5500_ENABLED
        help
            SPI chip-select pin. XIAO W5500 adapter uses D1, which on the
            XIAO ESP32-S3 is GPIO2 (the D-number is NOT the GPIO number).

    config ETH_W5500_SCK_GPIO
        int "W5500 SCK GPIO"
        default 7
        depends on ETH_W5500_ENABLED
        help
            SPI clock pin. XIAO W5500 adapter uses D8/SCK, which on the
            XIAO ESP32-S3 is GPIO7.

    config ETH_W5500_MISO_GPIO
        int "W5500 MISO GPIO"
        default 8
        depends on ETH_W5500_ENABLED
        help
            SPI MISO pin. XIAO W5500 adapter uses D9/MISO, which on the
            XIAO ESP32-S3 is GPIO8.

    config ETH_W5500_MOSI_GPIO
        int "W5500 MOSI GPIO"
        default 9
        depends on ETH_W5500_ENABLED
        help
            SPI MOSI pin. XIAO W5500 adapter uses D10/MOSI, which on the
            XIAO ESP32-S3 is GPIO9.

    config ETH_W5500_INT_GPIO
        int "W5500 INT GPIO (-1 = polling)"
        default -1
        depends on ETH_W5500_ENABLED
        help
            Interrupt GPIO for receive notification. -1 uses 10 ms polling
            instead, which is reliable and avoids wiring an extra pin.
            XIAO W5500 adapter exposes this on GPIO16 (D16) if you want it.

    config ETH_W5500_SPI_HOST
        int "SPI host (1 = SPI2_HOST, 2 = SPI3_HOST)"
        default 1
        depends on ETH_W5500_ENABLED
        help
            SPI peripheral to use. 1 (SPI2_HOST) is correct for the XIAO
            W5500 adapter; SPI2 can be routed to any GPIO via the GPIO matrix.

    config ETH_W5500_SPI_CLOCK_MHZ
        int "W5500 SPI clock speed (MHz)"
        range 1 40
        default 20
        depends on ETH_W5500_ENABLED
        help
            SPI clock for the W5500. 20 MHz is conservative and reliable;
            the chip supports up to 80 MHz but cable length and board layout
            limit practical speeds. Raise to 40 MHz if throughput matters.

endmenu

menu "Example Configuration"

    menu "SoftAP Configuration"
        comment "SoftAP Configuration"

        config ESP_WIFI_AP_SSID
            string "WiFi AP SSID"
            default "ESP32-TSR-Setup"
            help
                SSID (network name) of the AP for the example to connect to.

        config ESP_WIFI_AP_PASSWORD
            string "WiFi AP Password"
            default "mypassword"
            help
                WiFi password of the AP for the example to use.

        config ESP_WIFI_AP_CHANNEL
            int "WiFi AP Channel"
            range 1 14
            default 1
            help
                WiFi channel (network channel) of the AP for the example to use.

        config ESP_MAX_STA_CONN_AP
            int "Maximal STA connections"
            default 4
            help
                Max number of the STA connects to AP.
    endmenu

    menu "STA Configuration"
        comment "STA Configuration"

        config ESP_WIFI_REMOTE_AP_SSID
            string "WiFi Remote AP SSID"
            default "otherapssid"
            help
                SSID (network name) for the example's sta to connect to.

        config ESP_WIFI_REMOTE_AP_PASSWORD
            string "WiFi Remote AP Password"
            default "otherappassword"
            help
                WiFi password for the example to use.

        config ESP_MAXIMUM_STA_RETRY
            int "Maximum retry"
            default 5
            help
                Set the maximum retry value to prevent the station from continuously
                attempting to reconnect to the Access Point (AP) when the AP doesn't exist.

        choice ESP_WIFI_SCAN_AUTH_MODE_THRESHOLD
            prompt "WiFi Scan auth mode threshold"
            default ESP_WIFI_AUTH_WPA2_PSK
            help
                The weakest authmode to accept in the scan mode.
                This value defaults to ESP_WIFI_AUTH_WPA2_PSK in case password is present
                and ESP_WIFI_AUTH_OPEN is used. Please select ESP_WIFI_AUTH_WEP / ESP_WIFI_AUTH_WPA_PSK
                in case AP is operating in WEP / WPA mode.

            config ESP_WIFI_AUTH_OPEN
                bool "OPEN"
            config ESP_WIFI_AUTH_WEP
                bool "WEP"
            config ESP_WIFI_AUTH_WPA_PSK
                bool "WPA PSK"
            config ESP_WIFI_AUTH_WPA2_PSK
                bool "WPA2 PSK"
            config ESP_WIFI_AUTH_WPA_WPA2_PSK
                bool "WPA/WPA2 PSK"
            config ESP_WIFI_AUTH_WPA3_PSK
                bool "WPA3 PSK"
            config ESP_WIFI_AUTH_WPA2_WPA3_PSK
                bool "WPA2/WPA3 PSK"
            config ESP_WIFI_AUTH_WAPI_PSK
                bool "WAPI PSK"
        endchoice

    endmenu
endmenu
```
